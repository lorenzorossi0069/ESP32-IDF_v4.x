## WiFiControl/main/Kconfig.projbuild
```kconfig
menu "Extra - WiFi AP Connection Configuration "
			
	config EXAMPLE_WIFI_CHANNEL
        int "WiFi Channel"
        default 1
        help
            Default WiFi channel for the example to use.

    config EXAMPLE_MAXIMUM_RETRY
        int "Maximum retry"
        default 5
        help
            Set the Maximum retry to avoid station reconnecting to the AP unlimited when the AP is really inexistent.
	
    config EXAMPLE_MAXIMUM_CONN
        int "Maximum connections"
        default 3
        help
            Set the Maximum devices that can connect to the AP.	
			
endmenu
```
